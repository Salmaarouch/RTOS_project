## manifest-repo/west.yml
```yaml
manifest:
  remotes:
    - name: zephyrproject-rtos
      url-base: https://github.com/zephyrproject-rtos
  projects:
    - name: zephyr
      remote: zephyrproject-rtos
      revision: v4.0.0
      import: true
    - name: zephyr-playground-app
      url: ssh://git@lmswet-bitbucket01.europe.leicams.com:7999/~andreas.heck/zephyr-playground-app.git
      revision: feature/MDM-1831
    - name: zephyr-device-management-app
      url: ssh://git@lmswet-bitbucket01.europe.leicams.com:7999/~andreas.heck/zephyr-device-management-app.git
      revision: main
    - name: framework
      path: modules/lib/framework
      url: ssh://git@lmswet-bitbucket01.europe.leicams.com:7999/pyr/framework.git
      revision: feature/MDM-1831
  self:
    path: manifest-repo
```

## west.yml
```yaml
manifest:
  remotes:
    - name: zephyrproject-rtos
      url-base: https://github.com/zephyrproject-rtos
    - name: zellaco
      url-base: https://github.com/Zellaco
  projects:
    - name: zephyr
      remote: zephyrproject-rtos
      revision: v3.7.0
      import: true
    - name: zephyrblog_example1
      remote: zellaco
      revision: main
  self:
    path: manifest-repo
```
